## sources/meta-customwificonfig/conf/layer.conf
```bitbake
# We have a conf and classes directory, add to BBPATH
BBPATH .= ":${LAYERDIR}"

# We have recipes-* directories, add to BBFILES
BBFILES += "${LAYERDIR}/recipes-*/*/*.bb \
            ${LAYERDIR}/recipes-*/*/*.bbappend"

BBFILE_COLLECTIONS += "meta-customwificonfig"
BBFILE_PATTERN_meta-customwificonfig = "^${LAYERDIR}/"
BBFILE_PRIORITY_meta-customwificonfig = "6"

LAYERDEPENDS_meta-customwificonfig = "core"
LAYERSERIES_COMPAT_meta-customwificonfig = "scarthgap"
```

## sources/swupdate-image-fullcmdline/conf/layer.conf
```bitbake
# We have a conf and classes directory, add to BBPATH
BBPATH .= ":${LAYERDIR}"

# We have recipes-* directories, add to BBFILES
BBFILES += "${LAYERDIR}/recipes-*/*/*.bb \
            ${LAYERDIR}/recipes-*/*/*.bbappend"

BBFILE_COLLECTIONS += "swupdate-image-fullcmdline"
BBFILE_PATTERN_swupdate-image-fullcmdline = "^${LAYERDIR}/"
BBFILE_PRIORITY_swupdate-image-fullcmdline = "999"

LAYERDEPENDS_swupdate-image-fullcmdline = "core"
LAYERSERIES_COMPAT_swupdate-image-fullcmdline = "scarthgap"
```

## sources/swupdate-webserver/conf/layer.conf
```bitbake
# We have a conf and classes directory, add to BBPATH
BBPATH .= ":${LAYERDIR}"

# We have recipes-* directories, add to BBFILES
BBFILES += "${LAYERDIR}/recipes-*/*/*.bb \
            ${LAYERDIR}/recipes-*/*/*.bbappend"

BBFILE_COLLECTIONS += "swupdate-webserver"
BBFILE_PATTERN_swupdate-webserver = "^${LAYERDIR}/"
BBFILE_PRIORITY_swupdate-webserver = "6"

LAYERDEPENDS_swupdate-webserver = "core"
LAYERSERIES_COMPAT_swupdate-webserver = "scarthgap"
```

## sources/yolox-ncnn-raspberry/conf/layer.conf
```bitbake
# We have a conf and classes directory, add to BBPATH
BBPATH .= ":${LAYERDIR}"

# We have recipes-* directories, add to BBFILES
BBFILES += "${LAYERDIR}/recipes-*/*/*.bb \
            ${LAYERDIR}/recipes-*/*/*.bbappend"

BBFILE_COLLECTIONS += "yolox-ncnn-raspberry"
BBFILE_PATTERN_yolox-ncnn-raspberry = "^${LAYERDIR}/"
BBFILE_PRIORITY_yolox-ncnn-raspberry = "7"

LAYERDEPENDS_yolox-ncnn-raspberry = "core"
LAYERSERIES_COMPAT_yolox-ncnn-raspberry = "scarthgap"
```
